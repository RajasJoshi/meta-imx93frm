## conf/layer.conf
```bitbake
# We have a conf and classes directory, add to BBPATH
BBPATH .= ":${LAYERDIR}"

# We have recipes-* directories, add to BBFILES
BBFILES += "${LAYERDIR}/recipes-*/*/*.bb \
            ${LAYERDIR}/recipes-*/*/*.bbappend"

BBFILE_COLLECTIONS += "meta-imx93frm"
BBFILE_PATTERN_meta-imx93frm = "^${LAYERDIR}/"
BBFILE_PRIORITY_meta-imx93frm = "9"

LAYERDEPENDS_meta-imx93frm = "core"
LAYERSERIES_COMPAT_meta-imx93frm = " wrynose "

UBOOT_SIGN_ENABLE   = "1"
UBOOT_SIGN_KEYDIR   = "${LAYERDIR}/keys"
UBOOT_SIGN_KEYNAME  = "dev"
FIT_SIGN_ALG        = "rsa2048"
FIT_HASH_ALG        = "sha256"
UBOOT_INITIAL_ENV_BINARY_SIZE = "0x200000"
KERNEL_DEVICETREE   = "freescale/imx93-11x11-frdm.dtb"
KERNEL_CLASSES += "kernel-fit-extra-artifacts"

SWUPDATE_SIGNING = "RSA"
SWUPDATE_ENCRYPT_IMAGES = "1"
SWUPDATE_ENCRYPT_SWDESC = "1"
SWUPDATE_PRIVATE_KEY = "${LAYERDIR}/keys/swu_priv.pem"
SWUPDATE_AES_FILE = "${LAYERDIR}/keys/swu_aes.key"
SWUPDATE_PUBLIC_KEY = "${LAYERDIR}/keys/swu_public.pem"
```
